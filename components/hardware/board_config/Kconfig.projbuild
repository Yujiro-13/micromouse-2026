## components/hardware/board_config/Kconfig.projbuild
```kconfig
menu "reRoMouse Board Hardware (GPIO / SPI / I2C)"

    comment "ボード固有のハードウェア配線。"

    config BOARD_PINS_FROM_MENUCONFIG
        bool "Use menuconfig values for board pins"
        default n
        help
            ピン割り当ての参照元を選ぶマスタースイッチ。
              n (既定): board_config.h にソース定義された値を使う。
              y       : 以下の menuconfig 項目の値を使う(基板移植・派生機向け)。
            どちらでも既定値は同一なので、切り替えても現行基板の配線は変わらない。

    if BOARD_PINS_FROM_MENUCONFIG

    menu "Startup output GPIOs"
        config BOARD_STARTUP_OUTPUT_GPIO0
            int "Startup output GPIO #0"
            range -1 48
            default 10
            help
                app_main 冒頭で出力設定する GPIO。未使用にする場合は -1。
        config BOARD_STARTUP_OUTPUT_GPIO1
            int "Startup output GPIO #1"
            range -1 48
            default 17
        config BOARD_STARTUP_OUTPUT_GPIO2
            int "Startup output GPIO #2"
            range -1 48
            default 18
        config BOARD_STARTUP_OUTPUT_GPIO3
            int "Startup output GPIO #3"
            range -1 48
            default 21
    endmenu

    menu "SPI bus: IMU(MPU6500) + Wall ADC(ADS7066)"
        choice BOARD_IMU_ADC_SPI_HOST
            prompt "IMU/ADC SPI host"
            default BOARD_IMU_ADC_SPI_HOST_SPI2
            config BOARD_IMU_ADC_SPI_HOST_SPI2
                bool "SPI2_HOST"
            config BOARD_IMU_ADC_SPI_HOST_SPI3
                bool "SPI3_HOST"
        endchoice
        config BOARD_IMU_ADC_SPI_MISO_GPIO
            int "IMU/ADC SPI MISO GPIO"
            range 0 48
            default 2
        config BOARD_IMU_ADC_SPI_MOSI_GPIO
            int "IMU/ADC SPI MOSI GPIO"
            range 0 48
            default 4
        config BOARD_IMU_ADC_SPI_SCLK_GPIO
            int "IMU/ADC SPI SCLK GPIO"
            range 0 48
            default 3
        config BOARD_ADC_CS_GPIO
            int "ADS7066 (ADC) chip select GPIO"
            range 0 48
            default 5
        config BOARD_IMU_CS_GPIO
            int "MPU6500 (IMU) chip select GPIO"
            range 0 48
            default 1
    endmenu

    menu "SPI bus: Encoders(MA730) left/right"
        choice BOARD_ENCODER_SPI_HOST
            prompt "Encoder SPI host"
            default BOARD_ENCODER_SPI_HOST_SPI3
            config BOARD_ENCODER_SPI_HOST_SPI2
                bool "SPI2_HOST"
            config BOARD_ENCODER_SPI_HOST_SPI3
                bool "SPI3_HOST"
        endchoice
        config BOARD_ENCODER_SPI_MOSI_GPIO
            int "Encoder SPI MOSI GPIO"
            range 0 48
            default 9
        config BOARD_ENCODER_SPI_MISO_GPIO
            int "Encoder SPI MISO GPIO"
            range 0 48
            default 8
        config BOARD_ENCODER_SPI_SCLK_GPIO
            int "Encoder SPI SCLK GPIO"
            range 0 48
            default 7
        config BOARD_ENCODER_LEFT_CS_GPIO
            int "Left encoder chip select GPIO"
            range 0 48
            default 6
        config BOARD_ENCODER_RIGHT_CS_GPIO
            int "Right encoder chip select GPIO"
            range 0 48
            default 14
    endmenu

    menu "I2C bus: LED driver(PCA9632)"
        config BOARD_LED_I2C_PORT
            int "LED I2C port number"
            range 0 1
            default 0
        config BOARD_LED_I2C_SDA_GPIO
            int "LED I2C SDA GPIO"
            range 0 48
            default 38
        config BOARD_LED_I2C_SCL_GPIO
            int "LED I2C SCL GPIO"
            range 0 48
            default 39
        config BOARD_LED_I2C_ADDR
            hex "PCA9632 I2C address (7bit)"
            range 0x00 0x7f
            default 0x62
        config BOARD_LED_I2C_CLOCK_HZ
            int "LED I2C clock (Hz)"
            range 100000 1000000
            default 1000000
    endmenu

    menu "Buzzer / NeoPixel"
        config BOARD_BUZZER_GPIO
            int "Buzzer GPIO"
            range 0 48
            default 15
        config BOARD_NEOPIXEL_GPIO
            int "NeoPixel (RGB LED) GPIO"
            range 0 48
            default 13
    endmenu

    menu "Motor driver"
        config BOARD_MOTOR_PHASE_RIGHT_GPIO
            int "Right motor PHASE GPIO"
            range 0 48
            default 41
        config BOARD_MOTOR_ENABLE_RIGHT_GPIO
            int "Right motor ENABLE GPIO"
            range 0 48
            default 42
        config BOARD_MOTOR_PHASE_LEFT_GPIO
            int "Left motor PHASE GPIO"
            range 0 48
            default 45
        config BOARD_MOTOR_ENABLE_LEFT_GPIO
            int "Left motor ENABLE GPIO"
            range 0 48
            default 46
        config BOARD_MOTOR_FAN_GPIO
            int "Suction fan motor GPIO"
            range 0 48
            default 11
        config BOARD_MOTOR_MODE_GPIO
            int "Motor driver MODE GPIO"
            range 0 48
            default 40
    endmenu

    endif # BOARD_PINS_FROM_MENUCONFIG

endmenu
```

## main/Kconfig.projbuild
```kconfig
menu "reRoMouse Application"

    menu "WiFi / Telemetry"
        comment "WiFi テレメトリ・ダッシュボード (HTTP + WebSocket)。"
        comment "OFF(既定)では関連コード/依存/タスクを一切ビルド・起動せず従来挙動と同一。"
        comment "競技ビルドは n を推奨。調整・デバッグ時のみ y。"

        config RMOUSE_WIFI_ENABLE
            bool "Enable WiFi telemetry feature (master switch)"
            default n
            help
                WiFi テレメトリ機能のマスタースイッチ。
                n(既定): WiFi 関連のコード・コンポーネント・タスクは一切
                         ビルド/起動されず、従来挙動と完全に同一(OFF=無いのと同じ)。
                y      : 下記設定で WiFi(AP/STA/APSTA)・HTTP/WebSocket サーバを起動する。

        choice RMOUSE_WIFI_MODE
            prompt "WiFi mode"
            depends on RMOUSE_WIFI_ENABLE
            default RMOUSE_WIFI_MODE_APSTA
            help
                起動時の WiFi 動作モード。APSTA は AP と STA を同時に起動する。

            config RMOUSE_WIFI_MODE_AP
                bool "AP only (機体がアクセスポイント／直結)"
            config RMOUSE_WIFI_MODE_STA
                bool "STA only (既存ルータへ接続)"
            config RMOUSE_WIFI_MODE_APSTA
                bool "AP + STA (同時)"
        endchoice

        comment "--- Access Point (AP) ---"

        config RMOUSE_WIFI_AP_SSID
            string "AP SSID"
            depends on RMOUSE_WIFI_ENABLE
            default "reromouse-ap"

        config RMOUSE_WIFI_AP_PASSWORD
            string "AP password (>=8 文字, 空=オープン)"
            depends on RMOUSE_WIFI_ENABLE
            default ""
            help
                空文字でオープン(認証なし)。WPA2 にする場合は 8 文字以上。
                秘匿したい値は git 管理外の sdkconfig / sdkconfig.defaults.* へ設定すること。

        config RMOUSE_WIFI_AP_CHANNEL
            int "AP channel"
            depends on RMOUSE_WIFI_ENABLE
            range 1 13
            default 1

        config RMOUSE_WIFI_AP_MAX_CONN
            int "AP max simultaneous connections"
            depends on RMOUSE_WIFI_ENABLE
            range 1 4
            default 2

        comment "--- Station (STA) ---"

        config RMOUSE_WIFI_STA_SSID
            string "STA SSID (接続先ルータ)"
            depends on RMOUSE_WIFI_ENABLE
            default ""

        config RMOUSE_WIFI_STA_PASSWORD
            string "STA password"
            depends on RMOUSE_WIFI_ENABLE
            default ""

        config RMOUSE_WIFI_MAX_RETRY
            int "STA connection max retry"
            depends on RMOUSE_WIFI_ENABLE
            range 0 100
            default 5

        comment "--- Naming / Server ---"

        config RMOUSE_WIFI_HOSTNAME
            string "Hostname (mDNS: <name>.local)"
            depends on RMOUSE_WIFI_ENABLE
            default "reromouse"

        config RMOUSE_TELEMETRY_PORT
            int "HTTP/WebSocket server port"
            depends on RMOUSE_WIFI_ENABLE
            range 1 65535
            default 80

        config RMOUSE_TELEMETRY_HZ
            int "Telemetry push rate [Hz]"
            depends on RMOUSE_WIFI_ENABLE
            range 1 50
            default 20

        config RMOUSE_TELEMETRY_AUTH_TOKEN
            string "WebSocket auth token (空=無効)"
            depends on RMOUSE_WIFI_ENABLE
            default ""
    endmenu

    menu "Debug / Log"
        comment "ESP_LOG のレベルは Component config -> Log -> Default log verbosity で調整。"
        comment "ここでは生 printf によるトレースの有効/無効を切り替える。"

        config RMOUSE_DEBUG_BOOT_TRACE
            bool "Boot trace via printf (run_micromouse init)"
            default y
            help
                run_micromouse 初期化中の "finish ..." トレース printf を出力する。
                量産・計測時は n にしてシリアル出力を減らせる。

        config RMOUSE_DEBUG_MAINLOOP_TRACE
            bool "Main loop trace via printf"
            default n
            help
                メインループのデバッグ printf を出力する(将来配線用の予約フラグ)。
    endmenu

endmenu
```
